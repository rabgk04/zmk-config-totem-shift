## config/boards/shields/macropad/Kconfig.defconfig
```kconfig
# Copyright (c) 2026 The ZMK Contributors
# SPDX-License-Identifier: MIT

if SHIELD_MACROPAD

config ZMK_KEYBOARD_NAME
    default "MACROPAD"

endif
```

## config/boards/shields/macropad/Kconfig.shield
```kconfig
# Copyright (c) 2026 The ZMK Contributors
# SPDX-License-Identifier: MIT

config SHIELD_MACROPAD
    def_bool $(shields_list_contains,macropad)
```

## config/boards/shields/totem_macropad/Kconfig.shield
```kconfig
# Copyright (c) 2026 The ZMK Contributors
# SPDX-License-Identifier: MIT

config SHIELD_TOTEM_MACROPAD
    def_bool $(shields_list_contains,totem_macropad)
```

## config/west.yml
```yaml
manifest:
  remotes:
    - name: zmkfirmware
      url-base: https://github.com/zmkfirmware
    - name: caksoylar
      url-base: https://github.com/caksoylar
    - name: tokyo2006
      url-base: https://github.com/tokyo2006
  projects:
    - name: zmk
      remote: zmkfirmware
      revision: v0.3.0
      import: app/west.yml
    - name: zmk-rgbled-widget
      remote: caksoylar
      revision: fbe6dde8ffa68fdcded1600a66aa18cf12a796fb
    - name: prospector-zmk-module
      remote: tokyo2006
      revision: support_nicenano
  self:
    path: config
```

## drivers/sensor/Kconfig
```kconfig
# Copyright (c) 2026 The ZMK Contributors
# SPDX-License-Identifier: MIT

if SENSOR

rsource "mt6701/Kconfig"

endif # SENSOR
```

## drivers/sensor/mt6701/Kconfig
```kconfig
# Copyright (c) 2026 The ZMK Contributors
# SPDX-License-Identifier: MIT

config MT6701
    bool "MT6701 14-bit Magnetic Angle Sensor"
    default y
    depends on DT_HAS_MAG_MT6701_ENABLED
    depends on I2C
    help
      Enable driver for the Magntek MT6701 14-bit magnetic angle sensor,
      accessed over I2C at 7-bit address 0x06.
```

## dts/bindings/behaviors/zmk,behavior-mouse-wheel.yaml
```yaml
description: Emit a relative mouse wheel report each time the behavior is pressed
compatible: "zmk,behavior-mouse-wheel"
include: one_param.yaml
```

## dts/bindings/sensor/mag,mt6701.yaml
```yaml
description: |
  Sensor driver for the Magntek MT6701 14-bit magnetic angle sensor,
  accessed over I2C at 7-bit address 0x06.

compatible: "mag,mt6701"

include: [i2c-device.yaml]

properties:
  poll-period-ms:
    type: int
    default: 5
    description: Polling interval in milliseconds  max-backlog-degrees:
    type: int
    default: 15
    description: |
      Largest rotation, in degrees, allowed to sit unreported. Excess is discarded so a
      fast spin saturates the scroll rate rather than queueing a burst the ZMK behavior
      queue cannot drain. Keep at or below 360 / triggers-per-rotation.
  min-report-interval-ms:
    type: int
    default: 30
    description: |
      Shortest gap between sensor triggers handed to the keymap. Must stay above the
      sensor binding's tap-ms, which is how fast the ZMK behavior queue drains.
```
